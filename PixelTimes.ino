#include <TimeLib.h>
#include <Ticker.h>
#include <EEPROM.h>
#include <ESP8266WiFi.h>
#include <WiFiClient.h>
#include <time.h>

#include <ESP8266HTTPClient.h>
#include <ESP8266WebServer.h>
#include <ESP8266mDNS.h>
#include <ArduinoOTA.h>
#include <ArduinoJson.h>
#include <NtpClientLib.h>
#include <P10_matrix.h>
#include <Fonts/TomThumb.h>
#include "FS.h"

//#define logging 1

MDNSResponder mdns;
ESP8266WebServer server(80);
Ticker display_ticker;

int brightness=0;
int dimm=0;
int show_weather=true;

unsigned long button_press_time=0;

File ff;

// Pins for LED MATRIX
#define P_LAT 16
#define P_A 5
#define P_B 4
#define P_C 15
#define P_OE 2
P10_MATRIX display( P_LAT, P_OE,P_A,P_B,P_C);

// Some standard colors
uint16_t myRED = display.color565(255, 0, 0);
uint16_t myGREEN = display.color565(0, 255, 0);
uint16_t myBLUE = display.color565(0, 0, 255);
uint16_t myWHITE = display.color565(255, 255, 255);
uint16_t myYELLOW = display.color565(255, 255, 0);
uint16_t myCYAN = display.color565(0, 255, 255);
uint16_t myMAGENTA = display.color565(255, 0, 255);
uint16_t myBLACK = display.color565(0, 0, 0);

uint16 myCOLORS[8]={myRED,myGREEN,myBLUE,myWHITE,myYELLOW,myCYAN,myMAGENTA,myBLACK};

// Array that keeps low/high temperatures and icons for two days
int    temperature_show_low[2];
int    temperature_show_high[2];
int    icon_show_low[2];
int    icon_show_high[2];

uint8_t static weather_icons_a[]={0x00,0x00,0x00,0x00,0x00,0x00,0x00,0x20,0x00,0x00,0x00,0x00,0x00,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0x00
  ,0x00,0x00,0x00,0x00,0x00,0x00,0x00,0x00,0xff,0xe0,0x00,0x00,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0x00
  ,0x00,0x00,0x00,0x00,0xff,0xe0,0x00,0x00,0x00,0x00,0x00,0x00,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0x00
  ,0x00,0x20,0x00,0x00,0x00,0x00,0xff,0xe0,0xff,0xe0,0xff,0xe0,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0x00
  ,0x00,0x00,0xff,0xe0,0x00,0x00,0xff,0xe0,0xff,0xe0,0xff,0xe0,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0x00
  ,0x00,0x00,0x00,0x00,0x00,0x00,0xff,0xe0,0xff,0xe0,0xff,0xe0,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0x00
  ,0x00,0x00,0x00,0x00,0xff,0xe0,0x00,0x00,0x00,0x00,0x00,0x00,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0x00
  ,0x00,0x00,0x00,0x00,0x00,0x00,0x00,0x00,0xff,0xe0,0x00,0x00,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0x00
  ,0x00,0x00,0x00,0x00,0x00,0x00,0x00,0x00,0x00,0x00,0x00,0x00,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0x00
  ,0x00,0x00,0x00,0x00,0x00,0x00,0x00,0x00,0x00,0x00,0x00,0x00,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0x00
};

uint8_t static weather_icons_b[]={0x00,0x00,0x00,0x00,0x00,0x20,0x00,0x00,0xff,0xe0,0x00,0x00,0x00,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0x00
  ,0x00,0x00,0xff,0xe0,0x00,0x00,0x00,0x00,0x00,0x00,0x00,0x00,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0x00
  ,0x00,0x20,0x00,0x00,0x00,0x00,0xff,0xe0,0xff,0xe0,0xff,0xe0,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0x00
  ,0x00,0x00,0x00,0x00,0xff,0xe0,0xff,0xe0,0xff,0xe0,0xff,0xe0,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0x00
  ,0xff,0xe0,0x00,0x00,0xff,0xe0,0xff,0xe0,0xff,0xe0,0xff,0xe0,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0x00
  ,0x00,0x00,0x00,0x00,0xff,0xe0,0xff,0xe0,0xff,0xe0,0xff,0xe0,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0x00
  ,0x00,0x00,0x00,0x00,0x00,0x00,0xff,0xe0,0xff,0xe0,0xff,0xe0,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0x00
  ,0x00,0x00,0xff,0xe0,0x00,0x00,0x00,0x00,0x00,0x00,0x00,0x00,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0x00
  ,0x00,0x00,0x00,0x00,0x00,0x00,0x00,0x00,0xff,0xe0,0x00,0x00,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0x20
  ,0x00,0x00,0x00,0x00,0x00,0x00,0x00,0x00,0x00,0x00,0x00,0x00,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0x00
};

unsigned long next_weather_update=0;
bool weather_get_error;
int sunset;

boolean syncEventTriggered = false; // True if a time even has been triggered
NTPSyncEvent_t ntpEvent; // Last triggered event

// This gets all the weather data from openweathermap
bool update_weather()
{
  dimm=-1;
  while (brightness>0)
  yield();

  display_ticker.detach();

  String response;

  // Fetch current day - only sunset time information used for now
  HTTPClient http;

  http.begin("http://api.openweathermap.org/data/2.5/weather?q=Berlin,DE&APPID=asdadasdasadadsdas"); //HTTP
  int httpCode = http.GET();
  if(httpCode > 0) {
    // HTTP header has been send and Server response header has been handled
    Serial.printf("[HTTP] GET... code: %d\n", httpCode);

    if(httpCode == HTTP_CODE_OK) {
      response=http.getString();
      int this_index = response.indexOf("sunset");
      this_index = response.indexOf(":",this_index);
      int next_index = response.indexOf(",",this_index);
      sunset=response.substring(this_index+1,next_index).toInt();

      //Serial.println(response);
      time_t time_now = now();
      #ifdef logging
      Serial.println("Got Sunrise at " + String (sunset) + " Now:" + String (time_now));
      #endif
    }
  } else {
    weather_get_error=true;
    Serial.printf("[HTTP] GET... failed, error: %s\n", http.errorToString(httpCode).c_str());

  }
  http.end();

  // Fetch forecast
  HTTPClient http2;

  http2.begin("http://api.openweathermap.org/data/2.5/forecast?q=Berlin,DE&APPID=sfsdfsdfsdsdfdsf"); //HTTP
  int httpCode2 = http2.GET();

  // httpCode will be negative on error
  if(httpCode2 > 0) {
    int len = http2.getSize();

    Serial.println("Response size: "  + String(len));
    // HTTP header has been send and Server response header has been handled
    Serial.printf("[HTTP] GET... code: %d\n", httpCode2);
    response="";
    // file found at server
    if(httpCode2 == HTTP_CODE_OK) {

      WiFiClient * stream = http2.getStreamPtr();

      // create buffer for read
      char buff[128] = { 0 };
      while(http2.connected() && (len > 0 || len == -1)) {
        // get available data size
        size_t size = stream->available();

        if(size) {
          // read up to 128 byte
          int c = stream->readBytes(buff, ((size > sizeof(buff)) ? sizeof(buff) : size));
          //Serial.println(buff);
          response+=String(buff);
          if(len > 0)
          len -= c;
          // Only get the first 10000 bytes
          if (len <10000)
          break;

        }
        delay(1);

      }
    }
    //Serial.println(response);
    weather_get_error=false;
    #ifdef logging
    Serial.println("Weather data received");
    #endif
    http2.end();

  } else {
    weather_get_error=true;
    Serial.printf("[HTTP] GET... failed, error: %s\n", http2.errorToString(httpCode2).c_str());

    // If is this the first fetch and it fails we show zeros
    if (temperature_show_low[0]>90)
    {
      temperature_show_low[0]=0;
      temperature_show_low[1]=0;
      temperature_show_high[0]=0;
      temperature_show_high[1]=0;

      icon_show_low[0]=1;
      icon_show_low[1]=1;
      icon_show_high[0]=1;
      icon_show_high[1]=1;
    }
    http2.end();
    display_ticker.attach(0.001, display_updater);

    dimm=1;
    return false;
  }
  Serial.println("Fetch weather successfull");
  // Ok ... we have some valid response data to work on

  // First day
  int last_index = response.lastIndexOf("dt\"");
  int this_index = response.indexOf("dt\"");
  int next_index =0;
  int day_index=0;

  // Fill high/low with dummy data
  temperature_show_low[0]=+99;
  temperature_show_low[1]=+99;
  temperature_show_high[0]=-99;
  temperature_show_high[1]=-99;

  icon_show_low[0]=-99;
  icon_show_low[1]=-99;
  icon_show_high[0]=+99;
  icon_show_high[1]=+99;

  // Loop over list to find the high/low weather data for today and tomorrow
  int loop_count=-1;
  while (this_index>0)
  {
    loop_count++;

    // Get time of data set
    this_index = response.indexOf(":",this_index);
    String time_stamp = response.substring(this_index+1,this_index+11);
    int time_stamp_int = time_stamp.toInt();
    int time_stamp_hour = hour(time_stamp_int);

    // Get temperature of data set
    this_index = response.indexOf("temp\"",this_index);
    this_index = response.indexOf(":",this_index);
    next_index = response.indexOf(",",this_index);

    String temperature = response.substring(this_index+1,next_index);
    int temperature_int = temperature.toInt()-273;

    // Get icon of data set
    this_index = response.indexOf("icon\"",this_index);
    this_index = response.indexOf(":",this_index);
    next_index = response.indexOf("\"",this_index+2);

    String icon = response.substring(this_index+2,next_index-1);
    String night_day = response.substring(next_index-1,next_index);
    int icon_int = icon.toInt();

    // Map fetched icon data to display icon
    switch (icon_int) {
      case 1:
      //do something when var equals 1
      icon_int=0;
      break;
      case 2:
      icon_int=1;
      //do something when var equals 2
      break;
      case 3:
      icon_int=2;
      //do something when var equals 2
      break;
      case 4:
      icon_int=3;
      //do something when var equals 2
      break;
      case 9:
      icon_int=5;
      //do something when var equals 2
      break;
      case 10:
      icon_int=4;
      //do something when var equals 2
      break;
      case 11:
      icon_int=6;
      //do something when var equals 2
      break;
      case 13:
      icon_int=7;
      //do something when var equals 2
      break;
      case 50:
      icon_int=8;
      //do something when var equals 2
      break;
      default:
      icon_int=8;
      break;
    }

    // If there is only one data-set before midnight on the current day we have to display something - just use that midgight data
    if ((time_stamp_hour==0))
    {
      if (loop_count==0)
      {
        temperature_show_low[day_index]=temperature_int;
        temperature_show_high[day_index]=temperature_int;

        icon_show_low[day_index]=icon_int;
        icon_show_high[day_index]=icon_int;
      }
      day_index++;
    }
    if (day_index==2)
    break;


    // Only use data between 6am and 6pm since we most likely will be inside otherwise
    if (((time_stamp_hour>=6)&&(time_stamp_hour<=18))||(temperature_show_low[day_index]>90)||(temperature_show_high[day_index]<-90))
    {
      #ifdef logging
      Serial.println(String(day_index) + " Temp: " + String(temperature_int)+", Icon: " + String(icon_int)+" "+String(night_day));
      #endif

      // Find the max and min over the day
      if (temperature_int<temperature_show_low[day_index])
      temperature_show_low[day_index]=temperature_int;

      if (temperature_int>temperature_show_high[day_index])
      temperature_show_high[day_index]=temperature_int;

      if (icon_int>icon_show_low[day_index])
      icon_show_low[day_index]=icon_int;

      if (icon_int<icon_show_high[day_index])
      icon_show_high[day_index]=icon_int;

    }
    this_index = response.indexOf("dt\"",this_index);

    yield();

  }


  #ifdef logging
  Serial.println("Last character used: " + String(this_index));
  Serial.println("T-Low 0:" + String(temperature_show_low[0])+ ", T-High:" + String(temperature_show_high[0]));
  Serial.println("T-Low 1:" + String(temperature_show_low[1])+ ", T-High:" + String(temperature_show_high[1]));
  Serial.println("I-Low 0:" + String(icon_show_low[0])+ ", I-High:" + String(icon_show_high[0]));
  Serial.println("I-Low 1:" + String(icon_show_low[1])+ ", I-High:" + String(icon_show_high[1]));
  #endif
  display_ticker.attach(0.001, display_updater);

  dimm=1;
  return true;
}

// Printing text with Adafruit GFX takes forever, so we create a frame buffer where
// we construct the frame (off-line) and then write it to the display
class buffer_draw : public Adafruit_GFX {
public:
  uint8_t frame_buffer[1536]={0};
  buffer_draw() : Adafruit_GFX(40,16) {}
  uint8_t bg_color[3];

  // We need that one so we can call ".print"
  void drawPixel(int16_t x, int16_t y, uint16_t color)

  {   if ((x>31)| (y>15))
    return;

    // We only do black or white for the writing
    if (((frame_buffer[60]+frame_buffer[61]+frame_buffer[62])/3)<120)
    {
      frame_buffer[x*3+y*96]=255;
      frame_buffer[x*3+y*96+1]=255;
      frame_buffer[x*3+y*96+2]=255;
    }
    else
    {
      frame_buffer[x*3+y*96]=0;
      frame_buffer[x*3+y*96+1]=0;
      frame_buffer[x*3+y*96+2]=0;
    }
  }
};

buffer_draw buffer_drawer;

// Handle NTP events
void processSyncEvent(NTPSyncEvent_t ntpEvent) {
  if (ntpEvent) {
    Serial.print("Time Sync error: ");
    if (ntpEvent == noResponse)
    Serial.println("NTP server not reachable");
    else if (ntpEvent == invalidAddress)
    Serial.println("Invalid NTP server address");
  }
  else {
    Serial.print("Got NTP time: ");
    Serial.println(NTP.getTimeDateString(NTP.getLastNTPSync()));
  }
}

// ISR for display refresh
void display_updater()
{
  // This implements dimming
  brightness=brightness+dimm;
  if (brightness<0)
  {
    brightness=0;
    dimm=0;
  }

  if (brightness>2100)
  {
    brightness=2100;
    dimm=0;
  }

  display.display(brightness/30);
}

// This is not 100% yet ... want to store wifi credentials in EPROM at some point
void start_wifi()
{

  Serial.println("Reading config from EEPROM");
  String esid;
  String pass;
  String ntp;

  esid="YourWifiNetwork";
  pass="YourWifiPass";
  ntp="0.de.pool.ntp.org";
  Serial.println("essid: " + esid);
  Serial.println("pass: " + pass);
  Serial.println("ntp: " + ntp);
  //WiFi.mode(WIFI_OFF);
  //delay(1000);
  WiFi.mode(WIFI_STA);
  WiFi.begin(esid.c_str(), pass.c_str());
  //server.close();

  // Wait for connection
  unsigned long start_connect=millis();
  while (WiFi.status() != WL_CONNECTED) {
    delay(500);
    Serial.print(".");

    if ((millis()-start_connect)>30000)
    ESP.restart();

  }
  Serial.println(WiFi.localIP());
  NTP.onNTPSyncEvent([](NTPSyncEvent_t event) {
    ntpEvent = event;
    syncEventTriggered = true;
  });
  NTP.begin(ntp.c_str(), 1, true);
  NTP.setInterval(63);
}

//


void button_pressed()
{
  if ((millis()-button_press_time)<500)
  return;
  show_weather=!show_weather;
  button_press_time=millis();

}
String filenames[100];
int no_files=0;
void setup() {
  // put your setup code here, to run once:
  SPIFFS.begin();
  Dir dir = SPIFFS.openDir("/");
  while (dir.next()) {

    Serial.print(dir.fileName());
    filenames[no_files]=dir.fileName();
    no_files++;
  }


  display.begin();
  display.clearDisplay();
  display.setTextColor(myCYAN);
  display.setCursor(2,0);
  display.print("Pixel");
  display.setTextColor(myMAGENTA);
  display.setCursor(2,8);
  display.print("Time");
  display.setTextColor(myWHITE);
  buffer_drawer.setFont(&TomThumb);


  Serial.begin(9600);

  start_wifi();

  display_ticker.attach(0.001, display_updater);
  attachInterrupt(digitalPinToInterrupt(0),button_pressed,FALLING);
  dimm=1;
  yield();
  delay(3000);


}

union single_double{
  uint8_t two[2];
  uint16_t one;
} this_single_double;

// This draws the weather icons and temperature
void draw_weather_icon (uint8_t icon, uint8_t location, int temp,bool ab)
{
  display.setFont(&TomThumb);

  if (location>2)
  location=2;

  if (icon>10)
  icon=10;
  for (int yy=0; yy<10;yy++)
  {
    for (int xx=0; xx<10;xx++)
    {
      uint16_t byte_pos=(xx+icon*10)*2+yy*220;
      if (ab){
        this_single_double.two[1]=weather_icons_a[byte_pos];
        this_single_double.two[0]=weather_icons_a[byte_pos+1];
      }
      else
      {
        this_single_double.two[1]=weather_icons_b[byte_pos];
        this_single_double.two[0]=weather_icons_b[byte_pos+1];
      }
      display.drawPixel(1+xx+location*12,yy,this_single_double.one);
    }

  }

  int pixel_shift=0;
  if ((temp>-10)&&(temp<10))
  pixel_shift=2;

  if (location==0)
  display.setCursor(2+pixel_shift,16);
  else
  display.setCursor(14+pixel_shift,16);

  if (temp<0)
  {
    temp=temp*-1;
    if (location==0)
    display.drawPixel(pixel_shift,13,myWHITE);
    else
    display.drawPixel(12+pixel_shift,13,myWHITE);
  }
  display.println(temp);
}

// This draws the time for the weather view
void draw_time_weather ()
{
  uint8_t this_hour= NTP.getHour();
  uint8_t this_minute= NTP.getMinute();
  uint8_t this_second= NTP.getSecond();
  display.setFont(&TomThumb);
  display.setTextColor(myWHITE);
  display.setCursor(25,6);
  if (this_hour<10)
  display.println("0"+String(this_hour));
  else
  display.println(this_hour);
  display.setCursor(25,16);

  if (this_minute<10)
  display.println("0"+String(this_minute));
  else
  display.println(this_minute);

  // Dots
  display.drawPixel(27,8,myWHITE);
  display.drawPixel(29,8,myWHITE);

}

// This draws the pixel animation to the frame buffer in animation view
void draw_animation ()
{
  uint32_t i=0;
  for (int yy=0;yy<16;yy++){
    for (int xx=0;xx<32;xx++){
      display.drawPixelRGB888(xx,yy,buffer_drawer.frame_buffer[i],buffer_drawer.frame_buffer[i+1],buffer_drawer.frame_buffer[i+2]);
      i=i+3;
    }
  }
}

// This draws the time to the frame buffer in animation view
void draw_time ()
{
  uint8_t this_hour= NTP.getHour();
  uint8_t this_minute= NTP.getMinute();

  String time_string;

  if (this_hour<10)
  time_string+= "0";

  time_string+= String(this_hour);
  time_string+= ":";

  if (this_minute<10)
  time_string+="0";
  time_string+=String(this_minute);
  buffer_drawer.setCursor(15,6);
  buffer_drawer.print(time_string);

}

void process_ntp()
{
  static int i = 0;
  static int last = 0;

  if (syncEventTriggered) {
    processSyncEvent(ntpEvent);
    syncEventTriggered = false;
  }
}

void loop() {
  if (show_weather)
  {

    bool ret_code;
    unsigned long this_time=millis();
    yield();
    // Update weather data every 10 minutes
    if (this_time>next_weather_update)
    {
      ret_code=update_weather();
      if (ret_code)
      next_weather_update=this_time+600000;
      else
      next_weather_update=this_time+5000;
    }

    display.clearDisplay();
    draw_time_weather ();

    // Exchange sun for moon icon when past sunset
    if ((sunset<now()) && (icon_show_low[0]<2))
    icon_show_low[0]=icon_show_low[0]+9;
    if ((sunset<now()) && (icon_show_high[0]<2))
    icon_show_high[0]=icon_show_high[0]+9;

    // Flip between icons every 2 seconds to animate them a bit
    // Flip between high and lows every 5 seconds
    if ((NTP.getSecond()%20)<10)
    {
      // Dot to indicate high or low
      display.drawPixel(0,15,myWHITE);
      draw_weather_icon(icon_show_low[0],0,temperature_show_low[0],(NTP.getSecond()%4>=2));
      draw_weather_icon(icon_show_low[0],0,temperature_show_low[0],(NTP.getSecond()%4<2));
      draw_weather_icon(icon_show_low[1],1,temperature_show_low[1],(NTP.getSecond()%4>=2));
      draw_weather_icon(icon_show_low[1],1,temperature_show_low[1],(NTP.getSecond()%4<2));
    }
    else
    {
      draw_weather_icon(icon_show_high[0],0,temperature_show_high[0],(NTP.getSecond()%4>=2));
      draw_weather_icon(icon_show_high[0],0,temperature_show_high[0],(NTP.getSecond()%4<2));
      draw_weather_icon(icon_show_high[1],1,temperature_show_high[1],(NTP.getSecond()%4>=2));
      draw_weather_icon(icon_show_high[1],1,temperature_show_high[1],(NTP.getSecond()%4<2));
      // Dot to indicate high or low
      display.drawPixel(0,11,myWHITE);
    }

    // If we had problems fetching the weather we display a red dot
    if (weather_get_error)
    display.drawPixel(0,0,myRED);

    server.handleClient();
    ArduinoOTA.handle();
    process_ntp();

    if (!show_weather)
    return;
    delay(100);

  }
  else
  {

    // Random animation file
    randomSeed(micros());
    uint8_t jump=random(no_files);
    unsigned long last_animation_change = millis();

    // Open file
    ff = SPIFFS.open(filenames[jump],"r");
    Serial.println("Now playing: " + String(filenames[jump]));
    int no_of_frames=ff.size()/1536;

    while(1)
    {

      if ((millis()-last_animation_change)>300000)
      break;
      int frame=0;

      while (1)
      {
        if (show_weather)
        return;

        // Copy current frame to frame buffer
        draw_animation ();
        unsigned long frame_end_time = millis();

        // Fetch new frame byte by byte - otherwise the fs will lock
        // and prevent timely display updates
        for (int this_byte=0;this_byte<1536;this_byte++){

          ff.read(buffer_drawer.frame_buffer+this_byte,1);
          yield();
        }
        unsigned long read_latency=millis()-frame_end_time;
        if (read_latency>100)
        Serial.println("Read latency problem, latency: " + String(read_latency));

        // Write time to frame buffer
        draw_time ();
        frame++;

        yield();
        process_ntp();

        if (frame==no_of_frames)
        {
          ff.seek(0,SeekSet);
          break;

        }
        while ((millis()-frame_end_time)<150)
        delay(1);
      }
    }
  }
}
